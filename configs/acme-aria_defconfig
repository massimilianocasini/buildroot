## configs/acme-aria_defconfig
```kconfig
BR2_arm=y
BR2_KERNEL_HEADERS_VERSION=y
BR2_DEFAULT_KERNEL_VERSION="4.4.5"
BR2_PACKAGE_HOST_LINUX_HEADERS_CUSTOM_4_4=y
BR2_TARGET_GENERIC_ROOT_PASSWD="acmesystems"
BR2_ROOTFS_OVERLAY="$(TOPDIR)/board/acmesystems/acme-aria/rootfs_overlay"
BR2_PACKAGE_LINUX_FIRMWARE=y
BR2_PACKAGE_LINUX_FIRMWARE_RALINK_RT2XX=y
BR2_PACKAGE_DROPBEAR=y
BR2_PACKAGE_IW=y
BR2_PACKAGE_WPA_SUPPLICANT=y
BR2_PACKAGE_WPA_SUPPLICANT_AP_SUPPORT=y
```

## configs/acme-foxg20_defconfig
```kconfig
BR2_arm=y
BR2_KERNEL_HEADERS_VERSION=y
BR2_DEFAULT_KERNEL_VERSION="4.4.5"
BR2_PACKAGE_HOST_LINUX_HEADERS_CUSTOM_4_4=y
BR2_TOOLCHAIN_BUILDROOT_WCHAR=y
BR2_TARGET_GENERIC_ROOT_PASSWD="acmesystems"
BR2_ROOTFS_OVERLAY="$(TOPDIR)/board/acmesystems/acme-foxg20/rootfs_overlay"
BR2_PACKAGE_LINUX_FIRMWARE=y
BR2_PACKAGE_LINUX_FIRMWARE_RALINK_RT2XX=y
BR2_PACKAGE_PYTHON=y
BR2_PACKAGE_PYTHON_FUTURE=y
BR2_PACKAGE_PYTHON_SERIAL=y
BR2_PACKAGE_PYTHON_SETUPTOOLS=y
BR2_PACKAGE_PYTHON_SMBUS_CFFI=y
BR2_PACKAGE_PYTHON_SPIDEV=y
BR2_PACKAGE_PYTHON_TELEGRAM_BOT=y
BR2_PACKAGE_CA_CERTIFICATES=y
BR2_PACKAGE_IW=y
BR2_PACKAGE_NTP=y
BR2_PACKAGE_OPENSSH=y
BR2_PACKAGE_WPA_SUPPLICANT=y
BR2_PACKAGE_WPA_SUPPLICANT_AP_SUPPORT=y
BR2_PACKAGE_NANO=y
```

## package/python-future/Config.in
```kconfig
config BR2_PACKAGE_PYTHON_FUTURE
	bool "python-future"
	depends on BR2_PACKAGE_PYTHON
	help
	  Clean single-source support for Python 3 and 2

	  https://pypi.python.org/pypi/future
```

## package/python-telegram-bot/Config.in
```kconfig
config BR2_PACKAGE_PYTHON_TELEGRAM_BOT
	bool "python-telegram-bot"
	depends on BR2_PACKAGE_PYTHON
	help
	  A Python wrapper around the Telegram Bot API

	  https://pypi.python.org/pypi/python-telegram-bot
```
